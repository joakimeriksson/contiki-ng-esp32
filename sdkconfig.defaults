## sdkconfig.defaults.esp32c6
```kconfig
# 802.15.4 radio for Contiki-NG's radio-esp32c6.c
CONFIG_BLINK_LED_STRIP=y
CONFIG_ESP_MAC_ADDR_UNIVERSE_IEEE802154=y
CONFIG_ESP_PHY_CALIBRATION_AND_DATA_STORAGE=y
CONFIG_ESP_PHY_CALIBRATION_MODE=0
CONFIG_ESP_PHY_ENABLED=y
CONFIG_ESP_PHY_IRAM_OPT=y
CONFIG_ESP_PHY_MAX_TX_POWER=20
CONFIG_ESP_PHY_MAX_WIFI_TX_POWER=20
CONFIG_ESP_PHY_PLL_TRACK_PERIOD_MS=1000
CONFIG_ESP_PHY_RF_CAL_PARTIAL=y
CONFIG_IEEE802154_CCA_ED=y
CONFIG_IEEE802154_CCA_MODE=1
CONFIG_IEEE802154_CCA_THRESHOLD=-60
CONFIG_IEEE802154_ENABLED=y
CONFIG_IEEE802154_INTERFACE_NUM=1
CONFIG_IEEE802154_PENDING_TABLE_SIZE=20
CONFIG_IEEE802154_RX_BUFFER_SIZE=20
CONFIG_IEEE802154_TIMING_OPTIMIZATION=y
```
